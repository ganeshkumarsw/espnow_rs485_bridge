## manifest/west.yml
```yaml
manifest:
  remotes:
    - name: zephyrproject
      url-base: https://github.com/zephyrproject-rtos
  projects:
    - name: zephyr
      repo-path: zephyr
      remote: zephyrproject
      import:
        path-prefix: deps
        name-allowlist:
          - picolibc
          - mcuboot
          - mbedtls
          - tf-psa-crypto
          - hal_espressif
          - hal_xtensa
          - littlefs
      revision: b04994206c693adfa9d5e4f1276a05b9d038a303
```
